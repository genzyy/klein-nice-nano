## config/boards/shields/klein/Kconfig.defconfig
```kconfig
if SHIELD_KLEIN_LEFT

config ZMK_KEYBOARD_NAME
    default "Klein"

config ZMK_SPLIT_ROLE_CENTRAL
    default y

endif

if SHIELD_KLEIN_LEFT || SHIELD_KLEIN_RIGHT

config ZMK_SPLIT
    default y

if ZMK_DISPLAY

config I2C
    default y

config SSD1306
    default y

endif # ZMK_DISPLAY

if LVGL

config LV_Z_VDB_SIZE
    default 64

config LV_DPI_DEF
    default 148

config LV_COLOR_DEPTH
    default LV_COLOR_DEPTH_1
endchoice

endif # LVGL

endif
```

## config/boards/shields/klein/Kconfig.shield
```kconfig
# Copyright (c) 2020 Pete Johanson
# SPDX-License-Identifier: MIT

config SHIELD_KLEIN_LEFT
    def_bool $(shields_list_contains,klein_left)

config SHIELD_KLEIN_RIGHT
    def_bool $(shields_list_contains,klein_left)
```
